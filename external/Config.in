## external/configs/ovng_defconfig
```kconfig
BR2_arm=y
BR2_cortex_a8=y
BR2_GLOBAL_PATCH_DIR="$(BR2_EXTERNAL_OVNG_PATH)/board/ovng/patches"
BR2_TOOLCHAIN_BUILDROOT_GLIBC=y
BR2_PACKAGE_HOST_LINUX_HEADERS_CUSTOM_4_19=y
BR2_TOOLCHAIN_BUILDROOT_CXX=y
BR2_TARGET_GENERIC_ISSUE="Welcome to OpenVarioNG"
BR2_ROOTFS_DEVICE_CREATION_DYNAMIC_EUDEV=y
BR2_TARGET_GENERIC_ROOT_PASSWD="ovng"
BR2_TARGET_GENERIC_GETTY_PORT="ttyS0"
# BR2_TARGET_GENERIC_REMOUNT_ROOTFS_RW is not set
BR2_ENABLE_LOCALE_WHITELIST="C en en_US de de_DE"
BR2_GENERATE_LOCALE="en_US de_DE"
BR2_SYSTEM_ENABLE_NLS=y
BR2_ROOTFS_OVERLAY="$(BR2_EXTERNAL_OVNG_PATH)/board/ovng/fs-overlay"
BR2_ROOTFS_POST_BUILD_SCRIPT="$(BR2_EXTERNAL_OVNG_PATH)/board/ovng/post-build.sh"
BR2_ROOTFS_POST_IMAGE_SCRIPT="$(BR2_EXTERNAL_OVNG_PATH)/board/ovng/post-image.sh"
BR2_LINUX_KERNEL=y
BR2_LINUX_KERNEL_CUSTOM_GIT=y
BR2_LINUX_KERNEL_CUSTOM_REPO_URL="https://github.com/beagleboard/linux.git"
BR2_LINUX_KERNEL_CUSTOM_REPO_VERSION="4.19.94-ti-r57"
BR2_LINUX_KERNEL_USE_CUSTOM_CONFIG=y
BR2_LINUX_KERNEL_CUSTOM_CONFIG_FILE="$(BR2_EXTERNAL_OVNG_PATH)/board/ovng/linux-4.19.config"
BR2_LINUX_KERNEL_DTS_SUPPORT=y
BR2_LINUX_KERNEL_INTREE_DTS_NAME="am335x-bone am335x-boneblack am335x-bonegreen am335x-bonegreen-wireless am335x-boneblue am335x-boneblack-uboot am335x-boneblack-uboot-univ am335x-bonegreen-wireless-uboot-univ am335x-bone-uboot-univ"
BR2_LINUX_KERNEL_INSTALL_TARGET=y
BR2_PACKAGE_LINUX_TOOLS_IIO=y
BR2_PACKAGE_BUSYBOX_CONFIG_FRAGMENT_FILES="$(BR2_EXTERNAL_OVNG_PATH)/board/ovng/busybox-ipc-syslog.config"
BR2_PACKAGE_BUSYBOX_SHOW_OTHERS=y
BR2_PACKAGE_ALSA_UTILS=y
BR2_PACKAGE_ALSA_UTILS_APLAY=y
BR2_PACKAGE_GETTEXT=y
BR2_PACKAGE_DOSFSTOOLS=y
BR2_PACKAGE_DOSFSTOOLS_MKFS_FAT=y
BR2_PACKAGE_E2FSPROGS=y
BR2_PACKAGE_DEJAVU=y
BR2_PACKAGE_IMAGEMAGICK=y
BR2_PACKAGE_EVTEST=y
BR2_PACKAGE_I2C_TOOLS=y
BR2_PACKAGE_UBOOT_TOOLS=y
BR2_PACKAGE_OPENSSL=y
BR2_PACKAGE_LIBGTK3=y
# BR2_PACKAGE_LIBGTK3_BROADWAY is not set
BR2_PACKAGE_LIBGTK3_DEMO=y
BR2_PACKAGE_LIBRSVG=y
BR2_PACKAGE_LIBSVG_CAIRO=y
BR2_PACKAGE_LIBSERIALPORT=y
BR2_PACKAGE_LIBCURL=y
BR2_PACKAGE_BOOST=y
BR2_PACKAGE_CAN_UTILS=y
BR2_PACKAGE_DROPBEAR=y
BR2_PACKAGE_IPROUTE2=y
BR2_PACKAGE_UTIL_LINUX_BINARIES=y
BR2_PACKAGE_UTIL_LINUX_HWCLOCK=y
BR2_PACKAGE_UTIL_LINUX_PARTX=y
BR2_TARGET_ROOTFS_EXT2=y
BR2_TARGET_ROOTFS_EXT2_4=y
BR2_TARGET_ROOTFS_EXT2_SIZE="512M"
BR2_TARGET_UBOOT=y
BR2_TARGET_UBOOT_BUILD_SYSTEM_KCONFIG=y
BR2_TARGET_UBOOT_CUSTOM_VERSION=y
BR2_TARGET_UBOOT_CUSTOM_VERSION_VALUE="2020.07"
BR2_TARGET_UBOOT_BOARD_DEFCONFIG="am335x_evm"
BR2_TARGET_UBOOT_CONFIG_FRAGMENT_FILES="$(BR2_EXTERNAL_OVNG_PATH)/board/ovng/uboot-enable-dtoverlay.config"
BR2_TARGET_UBOOT_NEEDS_DTC=y
# BR2_TARGET_UBOOT_FORMAT_BIN is not set
BR2_TARGET_UBOOT_FORMAT_IMG=y
BR2_TARGET_UBOOT_SPL=y
BR2_TARGET_UBOOT_SPL_NAME="MLO"
BR2_TARGET_UBOOT_ENVIMAGE=y
BR2_TARGET_UBOOT_ENVIMAGE_SOURCE="$(BR2_EXTERNAL_OVNG_PATH)/board/ovng/uEnv.txt"
BR2_TARGET_UBOOT_ENVIMAGE_SIZE="0x20000"
BR2_PACKAGE_HOST_DOSFSTOOLS=y
BR2_PACKAGE_HOST_GENIMAGE=y
BR2_PACKAGE_HOST_MTOOLS=y
BR2_PACKAGE_HOST_UBOOT_TOOLS=y
BR2_PACKAGE_HOST_UBOOT_TOOLS_FIT_SUPPORT=y
BR2_PACKAGE_HOST_UBOOT_TOOLS_FIT_SIGNATURE_SUPPORT=y
BR2_PACKAGE_OVNG_OVERLAYS=y
BR2_PACKAGE_OVNGD=y
BR2_PACKAGE_XCSOAR=y
BR2_PACKAGE_ICM20948=y
BR2_PACKAGE_AMS5915=y
BR2_PACKAGE_WESTON_TI=y
BR2_PACKAGE_TI_IMG_SGX_KM=y
BR2_PACKAGE_TI_IMG_SGX_UM=y
```

## external/package/Config.in
```kconfig
menu "OpenVario"
	source "$BR2_EXTERNAL_OVNG_PATH/package/ovng-overlays/Config.in"
	source "$BR2_EXTERNAL_OVNG_PATH/package/ovngd/Config.in"
	source "$BR2_EXTERNAL_OVNG_PATH/package/xcsoar/Config.in"
	source "$BR2_EXTERNAL_OVNG_PATH/package/icm20948/Config.in"
	source "$BR2_EXTERNAL_OVNG_PATH/package/ams5915/Config.in"
endmenu

menu "Graphic libraries and applications (graphic/text)"
	source "$BR2_EXTERNAL_OVNG_PATH/package/weston-ti/Config.in"
endmenu

menu "Hardware handling"
	source "$BR2_EXTERNAL_OVNG_PATH/package/ti-img-sgx-km/Config.in"
	source "$BR2_EXTERNAL_OVNG_PATH/package/ti-img-sgx-um/Config.in"
endmenu
```

## external/package/ams5915/Config.in
```kconfig
config BR2_PACKAGE_AMS5915
	bool "ams5915"
	depends on BR2_LINUX_KERNEL
	help
	  IIO driver for AMS4915 preassure Amplified pressure sensor
	  with digital output (I2C).

	  https://www.amsys.de/downloads/data/ams5915-AMSYS-datasheet.pdf

comment "ams5915 needs a Linux kernel to be built"
	depends on !BR2_LINUX_KERNEL
```

## external/package/bborg-overlays/Config.in
```kconfig
config BR2_PACKAGE_BBORG_OVERLAYS
	bool "bborg-overlays"
	depends on BR2_arm # only relevant for TI am335x
	select BR2_PACKAGE_HOST_DTC
	help
	  beaglebone.org device tree overlays

	  https://github.com/beagleboard/bb.org-overlays
```

## external/package/icm20948/Config.in
```kconfig
config BR2_PACKAGE_ICM20948
	bool "icm20948"
	depends on BR2_LINUX_KERNEL
	help
	  Simple IIO driver for ICM20948 9-Axis MEMS MotionTracking Device (I2C mode only).

	  http://www.invensense.com/wp-content/uploads/2016/06/DS-000189-ICM-20948-v1.3.pdf

comment "icm20948 needs a Linux kernel to be built"
	depends on !BR2_LINUX_KERNEL
```

## external/package/ovng-overlays/Config.in
```kconfig
config BR2_PACKAGE_OVNG_OVERLAYS
	bool "ovng-overlays"
	depends on BR2_arm # only relevant for TI am335x
	select BR2_PACKAGE_HOST_DTC
	help
	  OpenVarioNG device tree overlays
```

## external/package/ovngd/Config.in
```kconfig
config BR2_PACKAGE_OVNGD
	bool "ovngd"
	help
	  OpenVarioNG sensor data NMEA server
```

## external/package/ti-img-sgx-km/Config.in
```kconfig
comment "ti-img-sgx-km needs a Linux kernel to be built"
	depends on BR2_arm
	depends on !BR2_LINUX_KERNEL

config BR2_PACKAGE_TI_IMG_SGX_KM
	bool "ti-img-sgx-km"
	depends on BR2_LINUX_KERNEL && BR2_arm
	select BR2_LINUX_NEEDS_MODULES
	help
	  Kernel modules for TI CPUs with SGX GPU.
	  This package supports AM335x, AM437x, AM4430 and AM5430.
	  It builds the kernel module and the user space binaries.
	  For older CPUs or kernels use the ti-gfx package.

	  Note: it needs a TI specific kernel to build properly.

	  https://git.ti.com/cgit/graphics/omap5-sgx-ddk-linux

if BR2_PACKAGE_TI_IMG_SGX_KM

choice
	prompt "Target"
	default BR2_PACKAGE_TI_IMG_SGX_KM_AM335X
	help
	  Select the SOC for which you would like to install drivers.

config BR2_PACKAGE_TI_IMG_SGX_KM_AM335X
	bool "AM335x"
	help
	  All AM335x derivatives

config BR2_PACKAGE_TI_IMG_SGX_KM_AM437X
	bool "AM437x"
	help
	  All AM437x derivatives

config BR2_PACKAGE_TI_IMG_SGX_KM_AM57XX
	bool "AM57xx"
	help
	  All DRA7x and AM57xx derivatives

config BR2_PACKAGE_TI_IMG_SGX_KM_AM654X
	bool "AM654x"
	help
	  All AM65x derivatives

endchoice

endif
```

## external/package/ti-img-sgx-um/Config.in
```kconfig
comment "ti-img-sgx-um needs the ti-img-sgx-km driver"
	depends on !BR2_PACKAGE_TI_IMG_SGX_KM

comment "ti-img-sgx-um needs a glibc toolchain w/ threads and udev /dev management"
	depends on !BR2_TOOLCHAIN_USES_GLIBC || !BR2_TOOLCHAIN_HAS_THREADS || !BR2_PACKAGE_HAS_UDEV

config BR2_PACKAGE_TI_IMG_SGX_UM
	bool "ti-img-sgx-um"
	depends on BR2_PACKAGE_TI_IMG_SGX_KM
	depends on BR2_TOOLCHAIN_HAS_THREADS # libdrm
	depends on BR2_PACKAGE_HAS_UDEV # ti-libgbm
	# pre-built binaries
	depends on BR2_TOOLCHAIN_USES_GLIBC
	select BR2_PACKAGE_LIBDRM
	select BR2_PACKAGE_LIBDRM_OMAP
	select BR2_PACKAGE_HAS_LIBEGL
	select BR2_PACKAGE_HAS_LIBGLES
	select BR2_PACKAGE_HAS_LIBEGL_WAYLAND
	select BR2_PACKAGE_HAS_POWERVR
	select BR2_PACKAGE_LIBFFI
	select BR2_PACKAGE_WAYLAND
	select BR2_PACKAGE_ZLIB
	help
	  Graphics libraries for TI CPUs with SGX5xx GPU.
	  This package supports AM335x, AM437x, AM4430 and AM5430.
	  For older CPUs or kernels use the ti-gfx package.

	  https://git.ti.com/cgit/graphics/omap5-sgx-ddk-um-linux

if BR2_PACKAGE_TI_IMG_SGX_UM

config BR2_PACKAGE_PROVIDES_LIBEGL
	default "ti-img-sgx-um"

config BR2_PACKAGE_PROVIDES_LIBGLES
	default "ti-img-sgx-um"

config BR2_PACKAGE_PROVIDES_POWERVR
	default "ti-img-sgx-um"

endif
```

## external/package/weston-ti/Config.in
```kconfig
comment "weston-ti needs udev and a toolchain w/ locale, threads, dynamic library, ti-sgx-um, headers >= 3.0"
	depends on !BR2_PACKAGE_HAS_UDEV || !BR2_TOOLCHAIN_HAS_THREADS || \
		!BR2_TOOLCHAIN_HEADERS_AT_LEAST_3_0 || BR2_STATIC_LIBS || \
		!BR2_ENABLE_LOCALE || !BR2_PACKAGE_TI_IMG_SGX_UM

config BR2_PACKAGE_WESTON_TI
	bool "weston-ti"
	depends on BR2_PACKAGE_HAS_UDEV
	depends on !BR2_STATIC_LIBS # wayland
	depends on BR2_TOOLCHAIN_HAS_THREADS # wayland
	depends on BR2_TOOLCHAIN_HEADERS_AT_LEAST_3_0
	depends on BR2_PACKAGE_TI_IMG_SGX_UM
	select BR2_PACKAGE_WAYLAND
	select BR2_PACKAGE_WAYLAND_PROTOCOLS
	select BR2_PACKAGE_LIBXKBCOMMON
	select BR2_PACKAGE_CAIRO
	select BR2_PACKAGE_CAIRO_PNG
	select BR2_PACKAGE_LIBPNG
	select BR2_PACKAGE_JPEG
	select BR2_PACKAGE_LIBINPUT
	select BR2_PACKAGE_LIBDRM
	# Runtime dependency
	select BR2_PACKAGE_XKEYBOARD_CONFIG
	help
	  Weston is the reference implementation of a Wayland
	  compositor, and a useful compositor in its own right.
	  Weston has various backends that lets it run on Linux kernel
	  modesetting and evdev input as well as under X11.

	  http://wayland.freedesktop.org/

if BR2_PACKAGE_WESTON

config BR2_PACKAGE_WESTON_TI_XWAYLAND
	bool "XWayland support"
	depends on BR2_PACKAGE_XORG7
	depends on BR2_PACKAGE_LIBEPOXY
	select BR2_PACKAGE_CAIRO
	select BR2_PACKAGE_LIBXCB
	select BR2_PACKAGE_XLIB_LIBX11
	select BR2_PACKAGE_XLIB_LIBXCURSOR

comment "XWayland support needs libepoxy and X.org enabled"
	depends on !BR2_PACKAGE_XORG7 || !BR2_PACKAGE_LIBEPOXY

config BR2_PACKAGE_WESTON_TI_DEMO_CLIENTS
	bool "demo clients"
	depends on BR2_USE_MMU # pango
	depends on BR2_TOOLCHAIN_HAS_SYNC_4 # pango
	depends on BR2_INSTALL_LIBSTDCPP # pango
	depends on BR2_TOOLCHAIN_HAS_THREADS # pango
	depends on BR2_USE_WCHAR # pango
	depends on BR2_PACKAGE_HAS_LIBGLES
	depends on BR2_PACKAGE_HAS_LIBEGL_WAYLAND
	select BR2_PACKAGE_PANGO
	help
	  This enables the installation of Weston's demo clients.

comment "demo clients needs an OpenGL ES provider, an OpenEGL-capable Wayland backend and a toolchain w/ wchar, threads, C++"
	depends on BR2_USE_MMU
	depends on BR2_TOOLCHAIN_HAS_SYNC_4
	depends on !BR2_INSTALL_LIBSTDCPP || !BR2_TOOLCHAIN_HAS_THREADS || \
		!BR2_USE_WCHAR || !BR2_PACKAGE_HAS_LIBGLES || \
		!BR2_PACKAGE_HAS_LIBEGL_WAYLAND

endif
```

## external/package/xcsoar/Config.in
```kconfig
config BR2_PACKAGE_XCSOAR
	bool "xcsoar"
	help
	  XCSoar is a tactical glide computer for Android, Linux, Mac OS X, and Windows.

	  https://www.xcsoar.org/
```
